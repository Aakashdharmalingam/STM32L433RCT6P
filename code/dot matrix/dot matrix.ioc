# file: dot matrix.ioc
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Mcu.Family=STM32L4
Mcu.Name=STM32L433RCTxP
Mcu.Package=LQFP64
NVIC.PriorityGroup=NVIC_PRIORITYGROUP_4
PA5.Signal=SPI1_SCK
ProjectManager.HeapSize=0x200
ProjectManager.StackSize=0x400
ProjectManager.TargetToolchain=STM32CubeIDE
RCC.AHBFreq_Value=16000000
RCC.APB1Freq_Value=16000000
RCC.APB1TimFreq_Value=16000000
RCC.APB2Freq_Value=16000000
RCC.APB2TimFreq_Value=16000000
RCC.CortexFreq_Value=16000000
RCC.HCLKFreq_Value=16000000
RCC.HSE_VALUE=8000000
RCC.HSI48_VALUE=48000000
RCC.HSI_VALUE=16000000
RCC.LSE_VALUE=32768
RCC.MSI_VALUE=4000000
RCC.SYSCLKFreq_VALUE=16000000
RCC.SYSCLKSource=RCC_SYSCLKSOURCE_HSI
RCC.VCOOutputFreq_Value=32000000
board=custom

// file: Core/Src/main.c
/* USER CODE BEGIN Header */
/**
  ******************************************************************************
  * @file           : main.c
  * @brief          : Main program body
  ******************************************************************************
  * @attention
  *
  * Copyright (c) 2025 STMicroelectronics.
  * All rights reserved.
  *
  * This software is licensed under terms that can be found in the LICENSE file
  * in the root directory of this software component.
  * If no LICENSE file comes with this software, it is provided AS-IS.
  *
  ******************************************************************************
  */
/* USER CODE END Header */
#include "main.h"

void SystemClock_Config(void);

/* USER CODE BEGIN 0 */
void send_data(uint8_t addr, uint8_t data);
/* USER CODE END 0 */

int main(void)
{

  /* USER CODE BEGIN 1 */
	uint8_t val;
	uint8_t font[26][8] = {
	    {0x18, 0x24, 0x42, 0x42, 0x7E, 0x42, 0x42, 0x00}, // A → {0x18, 0x24, 0x42, 0x42, 0x7E, 0x42, 0x42, 0x00}
	    {0x3E, 0x42, 0x42, 0x3E, 0x42, 0x42, 0x3E, 0x00}, // B
	    {0x3C, 0x42, 0x01, 0x01, 0x01, 0x42, 0x3C, 0x00}, // C
	    {0x1E, 0x22, 0x42, 0x42, 0x42, 0x22, 0x1E, 0x00}, // D
	    {0x7E, 0x02, 0x02, 0x3E, 0x02, 0x02, 0x7E, 0x00}, // E
	    {0x7E, 0x02, 0x02, 0x3E, 0x02, 0x02, 0x02, 0x00}, // F
	    {0x3C, 0x42, 0x01, 0x71, 0x41, 0x42, 0x3C, 0x00}, // G
	    {0x42, 0x42, 0x42, 0x7E, 0x42, 0x42, 0x42, 0x00}, // H
	    {0x7C, 0x10, 0x10, 0x10, 0x10, 0x10, 0x7C, 0x00}, // I
	    {0x78, 0x20, 0x20, 0x20, 0x21, 0x21, 0x1E, 0x00}, // J
	    {0x42, 0x22, 0x12, 0x0E, 0x12, 0x22, 0x42, 0x00}, // K
	    {0x02, 0x02, 0x02, 0x02, 0x02, 0x02, 0x7E, 0x00}, // L
	    {0x42, 0x66, 0x5A, 0x5A, 0x42, 0x42, 0x42, 0x00}, // M
	    {0x42, 0x46, 0x4A, 0x52, 0x62, 0x42, 0x42, 0x00}, // N
	    {0x3C, 0x42, 0x42, 0x42, 0x42, 0x42, 0x3C, 0x00}, // O
	    {0x3E, 0x42, 0x42, 0x3E, 0x02, 0x02, 0x02, 0x00}, // P
	    {0x3C, 0x42, 0x42, 0x42, 0x4A, 0x32, 0x5C, 0x00}, // Q
	    {0x3E, 0x42, 0x42, 0x3E, 0x12, 0x22, 0x42, 0x00}, // R
	    {0x3C, 0x42, 0x02, 0x3C, 0x40, 0x42, 0x3C, 0x00}, // S
	    {0xFE, 0x10, 0x10, 0x10, 0x10, 0x10, 0x10, 0x00}, // T
	    {0x42, 0x42, 0x42, 0x42, 0x42, 0x42, 0x3C, 0x00}, // U
	    {0x42, 0x42, 0x42, 0x42, 0x42, 0x24, 0x18, 0x00}, // V
	    {0x42, 0x42, 0x42, 0x5A, 0x5A, 0x66, 0x42, 0x00}, // W
	    {0x42, 0x42, 0x24, 0x18, 0x24, 0x42, 0x42, 0x00}, // X
	    {0x42, 0x42, 0x24, 0x18, 0x10, 0x10, 0x10, 0x00}, // Y
	    {0x7E, 0x40, 0x20, 0x10, 0x08, 0x04, 0x7E, 0x00}  // Z
	};

  /* USER CODE END 1 */

  /* MCU Configuration--------------------------------------------------------*/

  /* Reset of all peripherals, Initializes the Flash interface and the Systick. */
  HAL_Init();

  /* Configure the system clock */
  SystemClock_Config();

  /* Initialize all configured peripherals */
  /* USER CODE BEGIN 2 */
//  clock
  RCC->APB2ENR |= RCC_APB2ENR_SPI1EN;
  RCC->AHB2ENR |= RCC_AHB2ENR_GPIOAEN;

  //PA4 pin ss
  GPIOA->MODER &= ~GPIO_MODER_MODE4_0;
  GPIOA->OSPEEDR |= (GPIO_OSPEEDER_OSPEEDR4_0 | GPIO_OSPEEDER_OSPEEDR4_1);
  GPIOA->AFR[0] |= (GPIO_AFRL_AFSEL4_0 | GPIO_AFRL_AFSEL4_2);

  //PA5 CLK
  GPIOA->MODER &= ~GPIO_MODER_MODE5_0;
  GPIOA->OSPEEDR |= (GPIO_OSPEEDER_OSPEEDR5_0 | GPIO_OSPEEDER_OSPEEDR5_1);
  GPIOA->AFR[0] |= (GPIO_AFRL_AFSEL5_0 | GPIO_AFRL_AFSEL5_2);

  //PA6 MISO pin
  GPIOA->MODER &= ~GPIO_MODER_MODE6_0;
  GPIOA->OSPEEDR |= (GPIO_OSPEEDER_OSPEEDR6_0 | GPIO_OSPEEDER_OSPEEDR6_1);
  GPIOA->AFR[0] |= (GPIO_AFRL_AFSEL6_0 | GPIO_AFRL_AFSEL6_2);

  //PA7 MOSI pin
  GPIOA->MODER &= ~GPIO_MODER_MODE7_0;
  GPIOA->OSPEEDR |= (GPIO_OSPEEDER_OSPEEDR7_0 | GPIO_OSPEEDER_OSPEEDR7_1);
  GPIOA->AFR[0] |= (GPIO_AFRL_AFSEL7_0 | GPIO_AFRL_AFSEL7_2);

  SPI1->CR1 |= SPI_CR1_CRCL | SPI_CR1_MSTR | SPI_CR1_BR_2;
  SPI1->CR2 |= SPI_CR2_DS_0 | SPI_CR2_DS_1 | SPI_CR2_DS_2 | SPI_CR2_DS_3;
  SPI1->CR2 |= SPI_CR2_SSOE | SPI_CR2_NSSP;
  SPI1->CR1 |= SPI_CR1_SPE;
 // data
// 16 data formate (8 + 8)
  send_data(0x09,0x00);
  send_data(0x0a,0x01);
  send_data(0x0b,0x07);
  send_data(0x0c,0x01);
  send_data(0x0f,0x00);
  uint8_t i,j;
  for(j=0;j<26;j++)
  {
	  for(i=1;i<=8;i++)
	  {
		  send_data(i,font[j][8-i]);

	  }
  	  HAL_Delay(1000);
  }
  /* USER CODE END 2 */

  /* Infinite loop */
  /* USER CODE BEGIN WHILE */
  while (1)
  {
	  val++;

    /* USER CODE END WHILE */

  }
}

void SystemClock_Config(void)
{
  RCC_OscInitTypeDef RCC_OscInitStruct = {0};
  RCC_ClkInitTypeDef RCC_ClkInitStruct = {0};

  /** Configure the main internal regulator output voltage
  */
  if (HAL_PWREx_ControlVoltageScaling(PWR_REGULATOR_VOLTAGE_SCALE1) != HAL_OK)
  {
    Error_Handler();
  }

  /** Initializes the RCC Oscillators according to the specified parameters
  * in the RCC_OscInitTypeDef structure.
  */
  RCC_OscInitStruct.OscillatorType = RCC_OSCILLATORTYPE_HSI;
  RCC_OscInitStruct.HSIState = RCC_HSI_ON;
  RCC_OscInitStruct.HSICalibrationValue = RCC_HSICALIBRATION_DEFAULT;
  RCC_OscInitStruct.PLL.PLLState = RCC_PLL_NONE;
  if (HAL_RCC_OscConfig(&RCC_OscInitStruct) != HAL_OK)
  {
    Error_Handler();
  }

  /** Initializes the CPU, AHB and APB buses clocks
  */
  RCC_ClkInitStruct.ClockType = RCC_CLOCKTYPE_HCLK|RCC_CLOCKTYPE_SYSCLK
                              |RCC_CLOCKTYPE_PCLK1|RCC_CLOCKTYPE_PCLK2;
  RCC_ClkInitStruct.SYSCLKSource = RCC_SYSCLKSOURCE_HSI;
  RCC_ClkInitStruct.AHBCLKDivider = RCC_SYSCLK_DIV1;
  RCC_ClkInitStruct.APB1CLKDivider = RCC_HCLK_DIV1;
  RCC_ClkInitStruct.APB2CLKDivider = RCC_HCLK_DIV1;

  if (HAL_RCC_ClockConfig(&RCC_ClkInitStruct, FLASH_LATENCY_0) != HAL_OK)
  {
    Error_Handler();
  }
}

/* USER CODE BEGIN 4 */
void send_data(uint8_t addr, uint8_t data)
{
	SPI1->DR = ((addr<<8)|data); // data formate for dot matrix
	while((SPI1->SR & SPI_SR_TXE) != SPI_SR_TXE); // wait for set TXE pin
}
/* USER CODE END 4 */

void Error_Handler(void)
{
  __disable_irq();
  while (1)
  {
  }
}
